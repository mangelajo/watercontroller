## crates/firmware/sdkconfig.defaults
```kconfig
# Match the ESPHome reference: 80 MHz CPU, size-optimized.
CONFIG_ESP_DEFAULT_CPU_FREQ_MHZ_80=y
CONFIG_ESP_DEFAULT_CPU_FREQ_MHZ=80
CONFIG_COMPILER_OPTIMIZATION_SIZE=y

# Logging — keep verbose available; runtime level is set in code.
CONFIG_LOG_DEFAULT_LEVEL_INFO=y
CONFIG_LOG_DEFAULT_LEVEL=3
CONFIG_LOG_MAXIMUM_LEVEL_VERBOSE=y
CONFIG_LOG_MAXIMUM_LEVEL=5

# Watchdog: be lenient during early bring-up; tighten later.
CONFIG_ESP_TASK_WDT_TIMEOUT_S=30

# Main task stack: ESP-IDF default is 3584 B which is tight once we layer
# WiFi supervisor + HTTPD config + MQTT cert plumbing on top of the Rust
# panic handler. Bump to 8 KB.
CONFIG_ESP_MAIN_TASK_STACK_SIZE=8192

# Custom partition table for OTA + NVS + SPA assets. Absolute path in the
# container is required when sdkconfig.defaults is provided via env var —
# CMake otherwise resolves the relative path against esp-idf-sys's synthetic
# project dir, where partitions.csv doesn't live.
CONFIG_PARTITION_TABLE_CUSTOM=y
CONFIG_PARTITION_TABLE_CUSTOM_FILENAME="/project/crates/firmware/partitions.csv"
CONFIG_PARTITION_TABLE_FILENAME="/project/crates/firmware/partitions.csv"

# 4 MB flash (matches the dev-kit ESP32-WROOM modules).
CONFIG_ESPTOOLPY_FLASHSIZE_2MB=n
CONFIG_ESPTOOLPY_FLASHSIZE_4MB=y
CONFIG_ESPTOOLPY_FLASHSIZE="4MB"

# OTA — enable rollback on boot failure.
CONFIG_BOOTLOADER_APP_ROLLBACK_ENABLE=y

# WiFi — use ESP-IDF defaults; we'll tune buffer sizes later if needed.
CONFIG_ESP_WIFI_ENABLED=y

# FreeRTOS tick rate — 1ms ticks for finer timing in valve sequencer.
CONFIG_FREERTOS_HZ=1000

# Open-cores ETH driver: only used under `--features qemu` to attach lwIP to
# QEMU's open_eth virtual NIC. Adds ~few KB on real hardware where it goes
# unused; cheap insurance for a ground-truth simulator.
CONFIG_ETH_USE_OPENETH=y

# WebSocket support in the ESP-IDF HTTP server (used for /ws/logs).
CONFIG_HTTPD_WS_SUPPORT=y

# mDNS responder so doremorwater.local resolves on the LAN.
CONFIG_MDNS_MAX_INTERFACES=2

# HTTPS server. The firmware spawns *two* EspHttpServer instances when a
# cert + key are configured: one plain on :80, one TLS on :443. With no cert
# the device falls back to HTTP-only on :80 (esp_https_server is still linked
# in but starts in HTTPD_SSL_TRANSPORT_INSECURE mode).
#
# Note: esp_https_server's HTTP-only fallback null-derefs under QEMU, so
# `--features qemu` builds may not boot. Real hardware works.
CONFIG_ESP_HTTPS_SERVER_ENABLE=y

# LWIP socket pool. Default is 10. Two HTTPD servers each bring (listening
# + control + N sessions) sockets — easy to overshoot 10 and start hitting
# `accept (23)` (ENFILE) errors. 16 leaves headroom for telnet (:23), the
# WebSocket fanout, and a couple browser tabs without hitting the cap.
CONFIG_LWIP_MAX_SOCKETS=16

# HTTPD request header buffer. Default 512 is too tight for a real browser
# (Chromium sends User-Agent + Accept-* + multiple Sec-* + WS-upgrade easily
# overflowing 512 B), producing 431 Request Header Fields Too Large. 1024
# is roomy for browser navigation; the cost is ~512 B of heap per active
# connection, which we've now got room for.
CONFIG_HTTPD_MAX_REQ_HDR_LEN=1024

# Note: max_uri_handlers is a RUNTIME parameter on httpd_config_t, not a
# Kconfig — set it on the Configuration struct in src/http_server.rs.

# mbedTLS memory tuning. Defaults are sized for an STA32 with 320 KB SRAM;
# on this device with two HTTPD servers running we have ~20 KB free heap at
# steady state and `mbedtls_ssl_setup` was returning ALLOC_FAILED on every
# handshake. Two changes:
#   1. DYNAMIC_BUFFER: only allocate the 16 KiB SSL read/write buffers when
#      a handshake is in flight, not pre-allocated per session. ~32 KB heap
#      saved at idle.
#   2. Lower the per-message buffer ceiling from 16 KiB → 4 KiB. The SPA's
#      JSON responses are <2 KiB; OTA upload is the only chunked path that
#      cares and it's HTTP-only.
CONFIG_MBEDTLS_DYNAMIC_BUFFER=y
CONFIG_MBEDTLS_SSL_IN_CONTENT_LEN=4096
CONFIG_MBEDTLS_SSL_OUT_CONTENT_LEN=4096

# TLS session resumption on the server. When a browser reconnects within
# the ticket lifetime it can skip the full ECDH handshake (~12 KiB peak
# transient alloc) and resume using the cached session keys. Single biggest
# win for "open SPA, navigate around, multiple parallel fetches" workloads.
CONFIG_ESP_TLS_SERVER_SESSION_TICKETS=y

# Trim mbedTLS curves and crypto we don't use. Keep:
#   SECP256R1     — our self-signed cert + most public CAs
#   SECP384R1     — some public CAs
#   CURVE25519    — X25519 ECDH key exchange
# Disable everything else (BP*, K1, 192R1, 224R1) — saves ~5 KiB code +
# a few KiB of one-time tables. RSA stays on so MQTT TLS to brokers
# keeps working.
# CONFIG_MBEDTLS_ECP_DP_SECP192R1_ENABLED is not set
# CONFIG_MBEDTLS_ECP_DP_SECP224R1_ENABLED is not set
# CONFIG_MBEDTLS_ECP_DP_SECP192K1_ENABLED is not set
# CONFIG_MBEDTLS_ECP_DP_SECP224K1_ENABLED is not set
# CONFIG_MBEDTLS_ECP_DP_SECP256K1_ENABLED is not set
# CONFIG_MBEDTLS_ECP_DP_BP256R1_ENABLED is not set
# CONFIG_MBEDTLS_ECP_DP_BP384R1_ENABLED is not set
# CONFIG_MBEDTLS_ECP_DP_BP512R1_ENABLED is not set
# CMAC isn't used by any TLS cipher suite we care about.
# CONFIG_MBEDTLS_CMAC_C is not set

# Heap-saving knobs that DON'T drop user-visible features (WPA3, IPv6,
# Enterprise auth and OTA are all preserved).
#
# WiFi buffer pools — defaults are tuned for hundreds of KB/s of throughput.
# This device serves sub-kB JSON; halving the dynamic buffer counts frees
# ~30 KiB heap with no observable impact on latency or capability.
CONFIG_ESP_WIFI_DYNAMIC_RX_BUFFER_NUM=16
CONFIG_ESP_WIFI_DYNAMIC_TX_BUFFER_NUM=16
# TCP/IP recv mailbox depth: 32 is generous; 8 is ample for our traffic.
CONFIG_LWIP_TCPIP_RECVMBOX_SIZE=8

# Enable FreeRTOS trace + run-time stats so /api/diag can call
# uxTaskGetSystemState() and surface per-task stack high-water marks.
# Cost is small — a few bytes per task struct + a free-running run-time
# counter. Worth it for the visibility while we tune RAM.
CONFIG_FREERTOS_USE_TRACE_FACILITY=y
CONFIG_FREERTOS_USE_STATS_FORMATTING_FUNCTIONS=y
CONFIG_FREERTOS_GENERATE_RUN_TIME_STATS=y

# PSRAM. On WROVER / ESP32-PICO modules with external SPI RAM, IDF maps
# it into the address space and (with USE_MALLOC) routes large allocations
# through it via `heap_caps_malloc(MALLOC_CAP_SPIRAM)`. On a WROOM (no
# PSRAM), the probe fails fast and IGNORE_NOTFOUND lets boot continue, at
# the cost of ~12 KiB of IRAM for the dead QPSRAM driver code — we accept
# that so the same firmware works on either module variant.
#
# USE_MALLOC adds PSRAM as a 32-bit-accessible heap pool that mbedTLS,
# lwIP buffers, log_buffer, and any unconstrained `Box::new` will pull
# from once on-chip DRAM is depleted, freeing the precious ~287 KiB of
# SRAM for code that requires 8-bit access (DMA buffers, ISR data).
CONFIG_SPIRAM=y
CONFIG_SPIRAM_BOOT_INIT=y
CONFIG_SPIRAM_USE_MALLOC=y
CONFIG_SPIRAM_TYPE_AUTO=y
CONFIG_SPIRAM_SPEED_40M=y
CONFIG_SPIRAM_IGNORE_NOTFOUND=y
# Threshold below which malloc tries SRAM first; above this it goes
# straight to PSRAM. 16 KiB is a reasonable cutoff: small allocs benefit
# from on-chip latency, large allocs wouldn't fit anyway.
CONFIG_SPIRAM_MALLOC_ALWAYSINTERNAL=16384
```
